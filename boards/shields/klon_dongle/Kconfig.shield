## boards/shields/klon_dongle/Kconfig.shield
```kconfig
config SHIELD_KLON_DONGLE_LEFT
    def_bool $(shields_list_contains,klon_dongle_left)

config SHIELD_KLON_DONGLE_RIGHT
    def_bool $(shields_list_contains,klon_dongle_right)

config SHIELD_KLON_DONGLE_DONGLE
    def_bool $(shields_list_contains,klon_dongle_dongle)
```
